## kconfig/Kconfig
```kconfig
mainmenu "hvisor platform options"

menu "Target architecture"
choice
	prompt "CPU architecture"
	default ARCH_AARCH64

config ARCH_AARCH64
	bool "aarch64"

config ARCH_RISCV64
	bool "riscv64"

config ARCH_LOONGARCH64
	bool "loongarch64"

config ARCH_X86_64
	bool "x86_64"

endchoice
endmenu

menu "AArch64 options"
	depends on ARCH_AARCH64

config AARCH64_UEFI_SUPPORT
	bool "UEFI memory map virtualization"
	default n

endmenu

menu "Interrupt controller"
	depends on ARCH_AARCH64 || ARCH_RISCV64 || ARCH_LOONGARCH64

choice
	prompt "GIC version"
	optional
	default IRQ_GICV3
	depends on ARCH_AARCH64

config IRQ_GICV2
	bool "GICv2"

config IRQ_GICV3
	bool "GICv3"

endchoice

config PLIC
	bool "PLIC"
	depends on ARCH_RISCV64
	default n

config DP1000_PLIC
	bool "DP1000 PLIC variant"
	depends on ARCH_RISCV64 && PLIC
	default n

config AIA
	bool "AIA (APLIC/IMSIC)"
	depends on ARCH_RISCV64
	default n

config ACLINT
	bool "ACLINT (MTI/MSI)"
	depends on ARCH_RISCV64
	default n

config LOONGSON_7A2000
	bool "Loongson 7A2000"
	depends on ARCH_LOONGARCH64
	default n

endmenu

menu "RISC-V options"
	depends on ARCH_RISCV64

config RVA23
	bool "RVA23 profile"
	default n
	select ISA_VECTOR
	select ISA_SSTC
	select ISA_SVPBMT
	select ISA_CMO
	help
	  Enable the RVA23 profile. RVA23 mandates the RISC-V Vector, Sstc,
	  Svpbmt, and base CMO extensions, so their ISA options are selected
	  automatically.

config ISA_VECTOR
	bool "V (Vector)"
	default n
	help
	  Enable guest Vector state. This sets the VS fields in sstatus and
	  vsstatus so that guests can execute RISC-V Vector instructions.

config ISA_SSTC
	bool "Sstc (Supervisor-mode timer interrupts)"
	default n
	help
	  Indicate that the host platform implements the RISC-V Sstc extension,
	  allowing hvisor to program stimecmp and vstimecmp. Direct VS-mode
	  access to vstimecmp is controlled separately for each guest.

config ISA_SVPBMT
	bool "Svpbmt (Page-Based Memory Types)"
	default n
	help
	  Enable the RISC-V Svpbmt extension. This sets HENVCFG.PBMTE so that
	  guests can use page-based memory types in their page-table entries.

config ISA_CMO
	bool "CMO (Base Cache Management Operations)"
	default n
	help
	  Enable the RISC-V base Cache Management Operation ISA extensions:
	  Zicbom for cache-block management, Zicbop for cache-block prefetch,
	  and Zicboz for cache-block zero.

config HYPERVISOR_V0_6
	bool "Hypervisor v0.6"
	default n

config EIC7700_SYSREG
	bool "EIC7700 system registers"
	depends on HYPERVISOR_V0_6
	default n

config SIFIVE_CCACHE
	bool "SiFive ccache"
	depends on HYPERVISOR_V0_6
	default n

endmenu

menu "LoongArch platform"
	depends on ARCH_LOONGARCH64

config LOONGSON_3A5000
	bool "Loongson 3A5000 CPU profile"
	default n

config LOONGSON_3A6000
	bool "Loongson 3A6000 CPU profile"
	default n
endmenu

menu "UART"

config PL011
	bool "PL011"
	depends on ARCH_AARCH64
	default n

config IMX_UART
	bool "iMX UART"
	depends on ARCH_AARCH64
	default n

config XUARTPS
	bool "XUARTPS"
	depends on ARCH_AARCH64
	default n

config UART_16550
	bool "UART_16550"
	depends on ARCH_AARCH64
	default n

config UART16550A
	bool "UART16550A"
	depends on ARCH_X86_64
	default n

config LOONGSON_UART
	bool "Loongson UART"
	depends on ARCH_LOONGARCH64
	default n

config SEQUENTIAL_OUTPUT
	bool "Wait for UART before writing console output"
	depends on ARCH_AARCH64 && (PL011 || UART_16550)
	default n
endmenu

menu "PCIe"

config PCI
	bool "PCI/PCIe support"
	default n

choice
	prompt "PCIe Architecture"
	depends on PCI
	default PCIE_ECAM

config PCIE_ECAM
	bool "ECAM PCIe"

config PCIE_DWC
	bool "DesignWare Core PCIe"

config PCIE_LOONGARCH64
	bool "LoongArch PCIe"
	depends on ARCH_LOONGARCH64

endchoice

config NO_PCIE_BAR_REALLOC
	bool "Do not reallocate PCIe BARs (board-specific)"
	depends on PCI
	default n

config DWC_MSI
	bool "DesignWare native MSI"
	depends on PCIE_DWC
	default n

config PCI_INIT_DELAY
	bool "Delay PCI init until guest DBI offset 0 access"
	depends on PCIE_DWC
	default n

config SRIOV
	bool "SR-IOV PF/VF enumeration and passthrough"
	depends on PCI
	default n

config VIRTIO_PCI
	bool "Virtio over PCI"
	depends on PCI && IRQ_GICV3
	default n
endmenu

menu "IOMMU"

config IOMMU
	bool
	default n

config ARM_SMMU
	bool "ARM SMMU"
	depends on ARCH_AARCH64
	select IOMMU
	default n

config INTEL_VTD
	bool "Intel VT-d"
	depends on ARCH_X86_64
	select IOMMU
	default n

config RISCV_IOMMU
	bool "RISC-V IOMMU"
	depends on ARCH_RISCV64
	select IOMMU
	default n

config SHARE_S2PT
	bool "Share stage-2 page tables with IOMMU (RISC-V IOMMU only)"
	depends on RISCV_IOMMU
	default n

config VIOMMU
	bool "Virtual RISC-V IOMMU"
	depends on RISCV_IOMMU
	default n
endmenu

menu "x86-specific options"
	depends on ARCH_X86_64

config GRAPHICS
	bool "Framebuffer / graphics"
	default n

config SPLIT_SCREEN
	bool "Split screen layout"
	depends on GRAPHICS
	default n

config PRINT_TIMESTAMP
	bool "Print timestamp in logs"
	default n
endmenu

menu "Debug"

config EXTIOI_DEBUG
	bool "EXTIOI debug (LoongArch LS7A2000)"
	depends on ARCH_LOONGARCH64
	default n
endmenu
```

## platform/aarch64/imx8mp/kconfig/defconfig
```kconfig
CONFIG_ARCH_AARCH64=y
CONFIG_IMX_UART=y
CONFIG_IRQ_GICV3=y
CONFIG_PCI=y
CONFIG_PCIE_DWC=y
CONFIG_NO_PCIE_BAR_REALLOC=y
CONFIG_DWC_MSI=y
CONFIG_PCI_INIT_DELAY=y
CONFIG_SRIOV=y
```

## platform/aarch64/jeston-orin/kconfig/defconfig
```kconfig
CONFIG_AARCH64_UEFI_SUPPORT=y
CONFIG_ARCH_AARCH64=y
CONFIG_IRQ_GICV3=y
CONFIG_SEQUENTIAL_OUTPUT=y
CONFIG_UART_16550=y
```

## platform/aarch64/qemu-gicv2/kconfig/defconfig
```kconfig
CONFIG_ARCH_AARCH64=y
CONFIG_ARM_SMMU=y
CONFIG_IOMMU=y
CONFIG_IRQ_GICV2=y
CONFIG_PCI=y
CONFIG_PCIE_ECAM=y
CONFIG_PL011=y
```

## platform/aarch64/rk3568/kconfig/defconfig
```kconfig
CONFIG_ARCH_AARCH64=y
CONFIG_IRQ_GICV3=y
CONFIG_NO_PCIE_BAR_REALLOC=y
CONFIG_PCI=y
CONFIG_PCIE_DWC=y
CONFIG_UART_16550=y
```

## platform/loongarch64/ls3a6000/kconfig/defconfig
```kconfig
CONFIG_ARCH_LOONGARCH64=y
CONFIG_LOONGSON_3A6000=y
CONFIG_LOONGSON_7A2000=y
CONFIG_LOONGSON_UART=y
CONFIG_NO_PCIE_BAR_REALLOC=y
CONFIG_PCI=y
CONFIG_PCIE_LOONGARCH64=y
```

## platform/riscv64/hifive-premier-p550/kconfig/defconfig
```kconfig
CONFIG_ARCH_RISCV64=y
CONFIG_EIC7700_SYSREG=y
CONFIG_HYPERVISOR_V0_6=y
CONFIG_PLIC=y
CONFIG_SIFIVE_CCACHE=y
```

## platform/riscv64/k3-com260/hvisor.its
```
/dts-v1/;

/ {
    description = "Hypervisor FIT Image";
    #address-cells = <2>;

    images {
        hvisor {
            description = "Hypervisor Kernel";
            data = /incbin/("hvisor.bin.tmp");
            type = "kernel";
            arch = "riscv";
            os = "linux";
            compression = "none";

            load = <0x1 0x02200000>;
            entry = <0x1 0x02200000>;
        };
    };

    configurations {
        default = "config_1";
        config_1 {
            description = "Boot Hypervisor with External FDT";
            kernel = "hvisor";
        };
    };
};
```

## platform/riscv64/qemu-aia/kconfig/defconfig
```kconfig
CONFIG_AIA=y
CONFIG_ARCH_RISCV64=y
CONFIG_IOMMU=y
CONFIG_PCI=y
CONFIG_PCIE_ECAM=y
CONFIG_RISCV_IOMMU=y
CONFIG_SHARE_S2PT=y
CONFIG_VIOMMU=y
CONFIG_SSTC=y
```

## platform/riscv64/qemu-plic/kconfig/defconfig
```kconfig
CONFIG_ACLINT=y
CONFIG_ARCH_RISCV64=y
CONFIG_PCI=y
CONFIG_PCIE_ECAM=y
CONFIG_PLIC=y
CONFIG_RVA23=y
```

## platform/x86_64/nuc14mnk/kconfig/defconfig
```kconfig
CONFIG_ARCH_X86_64=y
CONFIG_GRAPHICS=y
CONFIG_NO_PCIE_BAR_REALLOC=y
CONFIG_PCI=y
CONFIG_PCIE_ECAM=y
CONFIG_SPLIT_SCREEN=y
CONFIG_UART16550A=y
```

## platform/x86_64/qemu/kconfig/defconfig
```kconfig
CONFIG_ARCH_X86_64=y
CONFIG_INTEL_VTD=y
CONFIG_IOMMU=y
CONFIG_NO_PCIE_BAR_REALLOC=y
CONFIG_PCI=y
CONFIG_PCIE_ECAM=y
CONFIG_UART16550A=y
```
